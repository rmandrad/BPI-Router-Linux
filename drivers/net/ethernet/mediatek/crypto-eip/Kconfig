## drivers/net/ethernet/mediatek/crypto-eip/Kconfig
```kconfig
# SPDX-License-Identifier: GPL-2.0-or-later

config MTK_CRYPTO_EIP_DDK
	tristate "MediaTek EIP-197 crypto engine (Rambus DDK)"
	depends on NET_MEDIATEK_SOC && ARM64 && OF
	depends on m
	help
	  Rambus Driver Development Kit for the Security-IP EIP-197 crypto
	  engine of the MediaTek MT7988. It builds four modules:

	    crypto-eip-ddk-ksupport  kernel support, binds the "crypto" DT node
	    crypto-eip-ddk-ctrl      global control, downloads the engine firmware
	    crypto-eip-ddk-ctrl-app  global control application
	    crypto-eip-ddk-engine    packet engine / classification (PEC, PCL)

	  Load them in that order. The engine firmware images
	  firmware_eip207_{ifpp,ipue,ofpp,opue}.bin must be in /lib/firmware.

	  The DT node must not also match the in-tree safexcel driver; give it
	  only the compatible "security-ip-197-srv".

	  This only brings the engine up. IPsec offload itself needs the
	  inline driver on top of it.

	  If unsure, say N.

config MTK_CRYPTO_EIP_INLINE
	tristate "MediaTek EIP-197 inline IPsec offload"
	depends on MTK_CRYPTO_EIP_DDK && MTK_PCE && NET_MEDIATEK_SOC
	depends on XFRM_OFFLOAD && NF_FLOW_TABLE
	depends on IPV6=y || IPV6=n
	depends on m
	select CRYPTO_HASH
	select CRYPTO_AES
	select CRYPTO_MD5
	select CRYPTO_SHA1
	select CRYPTO_SHA256
	select CRYPTO_SHA512
	help
	  Inline IPsec ESP offload on the EIP-197 engine of the MT7988. The
	  driver registers as an xfrm packet-offload device for the MediaTek
	  Ethernet MACs (and DSA ports on top of them): outbound packets are
	  encrypted by the engine on their way to the PSE, inbound ESP
	  packets are decrypted by the engine before they reach the CPU, and
	  both directions can be accelerated by the PPE flow offload.

	  Requires the CONFIG_MTK_CRYPTO_EIP_DDK modules to be loaded
	  first. Only ESP tunnel and transport mode with the algorithms
	  rfc4106(gcm(aes)), rfc4543(gcm(aes)), rfc4309(ccm(aes)),
	  cbc(aes|des|des3_ede) with hmac(md5|sha1|sha256|sha384|sha512)
	  are handled. IPsec on top of PPP interfaces is not supported.

	  Use ip xfrm with "offload packet dev <ethernet device>" on both
	  the states and the policies.

	  If unsure, say N.
```

## drivers/net/ethernet/mediatek/npu/Kconfig
```kconfig
# SPDX-License-Identifier: GPL-2.0-or-later

config MTK_NPU
	tristate "MediaTek Network Processing Unit (TOPS) offload"
	depends on NET_MEDIATEK_SOC && ARM64 && OF && DEBUG_FS
	depends on MTK_PCE && MTK_SCPSYS_MT7988
	depends on m
	select DMA_ENGINE
	select DMA_VIRTUAL_CHANNELS
	help
	  Support for the MediaTek MT7988 Network Processing Unit (TOPS),
	  a set of offload cores that perform tunnel encapsulation and
	  decapsulation (L2oGRE, VxLAN, L2TP, PPTP, ...) for the packet
	  engine. This is the core driver: it loads the firmware, brings the
	  cores up and exposes the tunnel offload operations. A frontend
	  (e.g. MTK_NPU_FLOW) hooks it to the flow offload framework.

	  Needs firmware/mediatek/tops-{mgmt,offload}.img in /lib/firmware.
	  Module only (npu.ko).

	  If unsure, say N.

if MTK_NPU

config MTK_NPU_FLOW
	tristate "NPU tunnel offload through the flow table framework"
	depends on NF_FLOW_TABLE
	help
	  Hook the NPU into nf_flow_table so that tunnel flows (selected
	  by the nftables flowtable) are offloaded to the NPU through the
	  PPE. Module only (npu-flow.ko).

config MTK_NPU_SECURE_FW
	bool "NPU secure firmware load"
	help
	  Load the NPU firmware through the secure monitor (SMC call)
	  instead of writing it into the NPU memory directly.

config MTK_NPU_MEM_TEST
	bool "NPU memory test at bring-up"
	depends on !MTK_NPU_SECURE_FW
	default y
	help
	  Write test patterns to NPU memory and read them back while the
	  NPU is brought up, to verify memory integrity and accessibility
	  from the host CPU.

config MTK_NPU_THERMAL
	bool "NPU thermal throttling"
	depends on THERMAL
	default y
	help
	  Throttle NPU usage (through MCU dynamic frequency scaling) when
	  the board temperature gets too high.

config MTK_NPU_LOGGER
	bool "NPU firmware logger"
	select RELAY
	help
	  Log the NPU firmware output to relayfs. Logging is off at run
	  time until enabled from user space.

config MTK_NPU_LOGGER_FW_DEFAULT_RUNNING
	bool "Start the NPU firmware logger by default"
	depends on MTK_NPU_LOGGER
	help
	  Turn the firmware logger on at boot, to capture the firmware cold
	  boot log.

menu "NPU tunnel protocols"

config MTK_NPU_GRETAP
	bool "L2oGRE (GRETAP) offload"
	depends on NET_IPGRE_DEMUX
	default y

config MTK_NPU_VXLAN
	bool "VxLAN offload"
	depends on VXLAN
	default y

config MTK_NPU_PPTP
	bool "PPTP offload"
	depends on PPTP
	default y

config MTK_NPU_L2TP_V2
	bool "L2TPv2 offload"
	depends on PPPOL2TP
	default y

endmenu

menu "NPU network features (special purpose)"

config MTK_NPU_ADPT_FWD
	bool "Adapter forward"
	help
	  Bridge WAN with another network port when the NPU receives a
	  specific type of packet. Not for normal use.

config MTK_NPU_L4S
	bool "L4S"
	help
	  L4S congestion control in the NPU. Incompatible with the other
	  NPU features. Not for normal use.

config MTK_NPU_RATE_LIMIT
	bool "Rate limit"
	help
	  Forward certain packet types through 4 QoS queues. Not for
	  normal use.

endmenu

endif # MTK_NPU

config NPU_TNL_NUM
	int
	default 32

config NPU_TNL_MAP_BIT
	int
	default 5

config NPU_TNL_TYPE_NUM
	int
	default 32
```

## drivers/net/ethernet/mediatek/pce/Kconfig
```kconfig
# SPDX-License-Identifier: GPL-2.0-or-later

config MTK_PCE
	tristate "MediaTek Packet Classification Engine (PCE)"
	depends on NET_MEDIATEK_SOC && ARM64
	help
	  Support for the MediaTek Packet Classification Engine in NETSYS.
	  The PCE matches inbound packets (IP protocol, destination address,
	  L4 header or data) and redirects them to a MediaTek offload engine:
	  the NPU (tunnel offload) or the EIP-197 inline crypto engine. It is
	  required by CONFIG_MTK_NPU and CONFIG_MTK_CRYPTO_EIP.

	  If unsure, say N.
```
